## demos/sine_wave/sine_wave_tier1/sample.yaml
```yaml
sample:
  name: Sine Wave Tier1 demo
common:
  build_only: true
  tags: zenbedded
tests:
  sample.zenbedded.sine_wave_tier1.wifi:
    platform_allow:
      - esp32s3_devkitc/esp32s3/procpu
    extra_args: SNIPPET=wifi
  sample.zenbedded.sine_wave_tier1.usb_cdc:
    platform_allow:
      - esp32s3_devkitc/esp32s3/procpu
    extra_args: SNIPPET=cdc-ecm
  sample.zenbedded.sine_wave_tier1.dual:
    platform_allow:
      - esp32s3_devkitc/esp32s3/procpu
    extra_args: SNIPPET="cdc-ecm;wifi"
  sample.zenbedded.sine_wave_tier1.ethernet:
    platform_allow:
      - stm32f746g_disco
    extra_args: SNIPPET=ethernet
```
